## config/west.yml
```yaml
manifest:
  remotes:
    - name: zmkfirmware
      url-base: https://github.com/zmkfirmware
    - name: sayu-hub
      url-base: https://github.com/sayu-hub
#   - name: caksoylar  # ここをコメントアウト（1箇所目）
#     url-base: https://github.com/caksoylar  # ここをコメントアウト（2箇所目）
  projects:
    - name: zmk
      remote: zmkfirmware
      revision: v0.2.1
      import: app/west.yml
    - name: zmk-pmw3610-driver
      remote: sayu-hub
      revision: main
#   - name: zmk-rgbled-widget  # ここから（3箇所目）
#     remote: caksoylar        # （4箇所目）
#     revision: main           # （5箇所目）
#     # もしその下に他の設定があればそこまで
  self:
    path: config
```
